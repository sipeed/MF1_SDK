## components/boards/Kconfig
```kconfig
config COMPONENT_BOARDS_ENABLE
        bool "Enbale boards component"
        default n

menu "Board config"
    depends on COMPONENT_BOARDS_ENABLE
endmenu
```

## components/drivers/Kconfig
```kconfig
menu "Drivers configuration"

    #audio
    osource "${SDK_PATH}/components/drivers/audio/Kconfig"

    # camera
    osource "${SDK_PATH}/components/drivers/camera/Kconfig"

    # lcd
    osource "${SDK_PATH}/components/drivers/lcd/Kconfig"

	#rtc
	osource "${SDK_PATH}/components/drivers/rtc/Kconfig"
    
    # sd_card
    osource "${SDK_PATH}/components/drivers/sd_card/Kconfig"

endmenu
```

## components/drivers/audio/Kconfig
```kconfig
menu "Audio Speaker"
    config ENABLE_SPK
        bool "enable speaker"
        default n
    
    choice SPK_TYPE
        depends on ENABLE_SPK
        bool "speaker type"
        default SPK_TYPE_PT8211

        config SPK_TYPE_ES8374
            bool "speaker use es8374"
        
        config SPK_TYPE_PT8211
            bool "speaker use pt8211"
    endchoice

    menu "ES8374 Pin configuration"
        depends on SPK_TYPE_ES8374

        config PIN_NUM_ES8374_MCLK
            int "es8374 pin mclk"
            default 19
        config PIN_NUM_ES8374_DIN
            int "es8374 pin din"
            default 18
        config PIN_NUM_ES8374_DOUT
            int "es8374 pin dout"
            default 34
        config PIN_NUM_ES8374_SCLK
            int "es8374 pin sclk"
            default 35
        config PIN_NUM_ES8374_WS
            int "es8374 pin ws"
            default 33

        config PIN_NUM_ES8374_I2C_SDA
            int "es8374 pin i2c sda"
            default 31

        config PIN_NUM_ES8374_I2C_SCL
            int "es8374 pin i2c scl"
            default 30
    endmenu

    menu "PT8211 configuration"
        depends on SPK_TYPE_PT8211

        config PIN_NUM_PT8211_DAT
            int "pt8211 dat pin num"
            default 18
        config PIN_NUM_PT8211_CLK
            int "pt8211 clk pin num"
            default 35
        config PIN_NUM_PT8211_WS
            int "pt8211 ws pin num"
            default 33
        config PIN_NUM_PT8211_PA_EN
            int "pt8211 pa_en pin num"
            default 11

        comment "------------------------------------------"

        config GPIO_NUM_PT8211_PA_EN
            int "gpio num of pt8211 pa en"
            default 2
    endmenu
endmenu
```

## components/drivers/camera/Kconfig
```kconfig
menu "Camera( Sensor ) configuration"

    comment "!!!DONT MODIFY CAMERA_RESOLUTION!!!"

    config ENABLE_CAMERA
        bool "enable camera"
        default y

    choice CAMERA_TYPE
        depends on ENABLE_CAMERA
        bool "Camera type"
        default CAMERA_GC0328_DUAL

        config CAMERA_OV2640
            bool "single ov2640"
            select NOT_MF1_BOARD
        config CAMERA_GC0328_SINGLE
            bool "single gc0328"
        config CAMERA_GC0328_DUAL
            bool "dual gc0328, IR+RGB"
    endchoice

    config CAMERA_RESOLUTION_WIDTH
        depends on ENABLE_CAMERA
        int "Camera resolution width"
        default 320
    config CAMERA_RESOLUTION_HEIGHT
        depends on ENABLE_CAMERA
        int "Camera resolution height"
        default 240
endmenu
```

## components/drivers/lcd/Kconfig
```kconfig
menu "LCD configuration"

    config ENABLE_LCD
        bool "enable lcd"
        default y

    choice LCD_TYPE
        depends on ENABLE_LCD

        bool "LCD driver type"
        default LCD_TYPE_ST7789

        config LCD_TYPE_ST7789
            bool "LCD use ST7789"
        config LCD_TYPE_SIPEED
            bool "LCD use sipeed board, not support now"
    endchoice

    menu "Lcd ( Display ) configuration"
        depends on ENABLE_LCD

        config LCD_WIDTH
            depends on LCD_TYPE_ST7789
            int "Lcd display size width"
            default 240
        config LCD_HEIGHT
            depends on LCD_TYPE_ST7789
            int "Lcd display size height"
            default 240

        config LCD_CLK_FREQ_MHZ
            depends on LCD_TYPE_ST7789
            int "lcd clk frequency MHZ"
            default 15
    endmenu

    menu "LCD Pin configuration"
        depends on ENABLE_LCD

        config PIN_NUM_LCD_RST
            int "LCD Pin RST"
            default 37
        config PIN_NUM_LCD_DCX
            int "LCD Pin DCX"
            default 38
        config PIN_NUM_LCD_WRX
            int "LCD Pin WRX"
            default 36
        config PIN_NUM_LCD_SCK
            int "LCD Pin SCK"
            default 39
    endmenu

    menu "LCD Pin Func configuration"
        depends on ENABLE_LCD

        config GPIOHS_NUM_LCD_DCX
            int "LCD Pin DCX bind with GPIOHS num"
            default 0
        config GPIOHS_NUM_LCD_RST
            int "LCD Pin RST bind with GPIOHS num"
            default 1
    endmenu

endmenu
```

## components/drivers/rtc/Kconfig
```kconfig
menu "RTC configuration"

    config ENABLE_RTC
        bool "enable rtc"
        default n

    choice RTC_TYPE
        depends on ENABLE_RTC
        bool "RTC Type"
        default RTC_TYPE_BM8563

        config RTC_TYPE_GM1302
            bool "rtc use gm1302"

        config RTC_TYPE_BM8563
            bool "rtc use bm8563"
    endchoice

    menu "GM1302 Pin configuration"
        depends on RTC_TYPE_GM1302

        config PIN_NUM_RTC_GM1302_RST 
            int "RTC GM1302 Pin RST"
            default 11
        config PIN_NUM_RTC_GM1302_DAT 
            int "RTC GM1302 Pin DAT"
            default 13
        config PIN_NUM_RTC_GM1302_CLK 
            int "RTC GM1302 Pin CLK"
            default 12
    endmenu

    menu "GM1302 Pin Func configuration"
        depends on RTC_TYPE_GM1302
        config GPIOHS_NUM_RTC_GM1302_RST 
            int "RTC GM1302 GPIOHS RST num"
            default 17
        config GPIOHS_NUM_RTC_GM1302_DAT
            int "RTC GM1302 GPIOHS DAT num"
            default 18
        config GPIOHS_NUM_RTC_GM1302_CLK
            int "RTC GM1302 GPIOHS CLK num"
            default 19
    endmenu

    menu "RTC BM8563 Pin configuration"
        depends on RTC_TYPE_BM8563
        config PIN_NUM_RTC_BM8563_SDA
            int "RTC BM8563 Pin SDA"
            default 31
        config PIN_NUM_RTC_BM8563_SCL
            int "RTC BM8563 Pin SCL"
            default 30
    endmenu

    menu "RTC BM8563 Pin Func configuration"
        depends on RTC_TYPE_BM8563
        config GPIOHS_NUM_RTC_BM8563_SDA
            int "RTC BM8563 GPIOHS SDA"
            default 17
        config GPIOHS_NUM_RTC_BM8563_SCL
            int "RTC BM8563 GPIOHS SCL"
            default 18
    endmenu
endmenu
```

## components/drivers/sd_card/Kconfig
```kconfig
menu "SPI TF card configuration"

    config ENABLE_SD_CARD
        bool "Enable SPI TF card"
        default n

    menu "SPI TF card configuration"
        depends on ENABLE_SD_CARD

        config PIN_NUM_SD_CARD_SCLK
            int "SPI TF card SCLK pin number"
            default 27
        config PIN_NUM_SD_CARD_MOSI
            int "SPI TF card MOSI pin number"
            default 28
        config PIN_NUM_SD_CARD_MISO
            int "SPI TF card MISO pin number"
            default 26
        config PIN_NUM_SD_CARD_CS
            int "SPI TF card CS pin number"
            default 29
    endmenu

    menu "SPI TF card Pin Func configuration"
        depends on ENABLE_SD_CARD

        config GPIOHS_NUM_SD_CARD_SCLK
            int "SPI TF card GPIOHS simulate SCK number"
            default 2
        config GPIOHS_NUM_SD_CARD_MOSI
            int "SPI TF card GPIOHS simulate MOSI number"
            default 3
        config GPIOHS_NUM_SD_CARD_MISO
            int "SPI TF card GPIOHS simulate MISO number"
            default 4
        config GPIOHS_NUM_SD_CARD_CS
            int "SPI TF card GPIOHS simulate CS number"
            default 5
    endmenu
endmenu
```

## components/third_party/Kconfig
```kconfig
menu "Third party config"
    config OOFATFS_ENABLE
			bool "Enbale oofatfs"
			default n
			select ENABLE_SD_CARD
endmenu
```

## components/utils/Kconfig
```kconfig
menu "utils config"
    
    menu "list config"
        config LIST_MAX_NUM
            int "list max num"
            default 1
        config LIST_NODE_MAX_NUM
            int "list node num"
            default 32
        config LIST_ITERATOR_MAX_NUM
            int "list iterator num"
            default 2
    endmenu
    
    config  ENABLE_CQUEUE
        bool "enable cqueue module"
        default n

    config ENABLE_JPEG_DECODE
        bool "enable jpeg decode"
        default y

    config ENABLE_JPEG_ENCODE
        bool "enable jpeg encode"
        default y

    # sd_card
    osource "${SDK_PATH}/components/utils/qrcode/Kconfig"

endmenu
```

## components/utils/qrcode/Kconfig
```kconfig
menuconfig ENABLE_QRCODE
        bool "enable qrcode scan"
        default y

    choice QRCODE_TYPE
        depends on ENABLE_QRCODE

        bool "Qrcode engine"
        default QRCODE_TYPE_QUIRC

        config QRCODE_TYPE_QUIRC
            bool "Qrcode decode use Quirc"
        config QRCODE_TYPE_ZBAR
            bool "Qrcode decode use Zbar"
    endchoice
```
