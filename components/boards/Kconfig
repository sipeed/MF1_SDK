## projects/MF1/main/Kconfig
```kconfig
menu "Application configuration"

	menu "Peripheral configuration"

		menu "Key configuration"

			config ENABLE_KEY
				bool "enable key"
				default y

			config PIN_NUM_USER_KEY
				depends on ENABLE_KEY
				int "User Key pin number"
				default 24

			config GPIOHS_NUM_USER_KEY
				depends on ENABLE_KEY
				int "User Key gpiohs number"
				default 6

			config USER_KEY_PRESS_VOL
				depends on ENABLE_KEY
				int "User key press High or Low"
				range 0 1
				default 1
		endmenu

		menu "Relay configuration"

			config ENABLE_RELAY
				bool "enable relay"
				default y

			config RELAY_NUM
				depends on ENABLE_RELAY
				int "relay num"
				range 1 2
				default 2

			menu "Relay Pin configuration"
				depends on ENABLE_RELAY

				if RELAY_NUM >= 1
				config PIN_NUM_RELAY_1
					int "relay 1 pin number"
					default 12
				endif

				if RELAY_NUM >= 2
					config PIN_NUM_RELAY_2
						int "relay 2 pin number"
						default 13
				endif
			endmenu

			menu "Relay Pin Func configuration"
				depends on ENABLE_RELAY
				if RELAY_NUM >= 1
					config GPIOHS_NUM_RELAY_1
						int "relay 1 gpiohs number"
						default 7
				endif
				if RELAY_NUM >= 2
					config GPIOHS_NUM_RELAY_2
						int "relay 2 gpiohs number"
						default 8
				endif
			endmenu

			if RELAY_NUM >= 1
				config RELAY_1_OPEN_VOL
					int "relay 1 open high or low"
					range 0 1
					default 1
			endif

			if RELAY_NUM >= 2
				config RELAY_2_OPEN_VOL
					int "relay 2 open high or low"
					range 0 1
					default 0
			endif
		endmenu

		comment "Above init in Uart Proto..."

		menu "IR Led configuration"

			config ENABLE_IR_LED
				bool "enable IR Led"
				default y

			config PIN_NUM_IR_LED
				depends on ENABLE_IR_LED
				int "IR Led pin number"
				default 32

			config GPIOHS_NUM_IR_LED
				depends on ENABLE_IR_LED
				int "IR Led gpiohs number"
				default 9
		endmenu

		menu "Flash Led configuration"

			config ENABLE_FLASH_LED
				bool "enable flash led"
				default n

			config PIN_NUM_FLASH_LED
				depends on ENABLE_FLASH_LED
				int "flash led pin number"
				default 18

			config GPIOHS_NUM_FLASH_LED
				depends on ENABLE_FLASH_LED
				int "flash led gpiohs number"
				default 10
		endmenu

		menu "RGB Led configuration"

			config ENABLE_RGB_LED
				bool "enable rgb led"
				default y

			menu "RGB Led Pin configuration"
				depends on ENABLE_RGB_LED

				config PIN_NUM_RGB_LED_R
					int "RGB Led Red pin number"
					default 21

				config PIN_NUM_RGB_LED_G
					int "RGB Led Green pin number"
					default 22

				config PIN_NUM_RGB_LED_B
					int "RGB Led Blue pin number"
					default 23
			endmenu

			menu "RGB Led Pin Func configuration"
				depends on ENABLE_RGB_LED

				config GPIOHS_NUM_RGB_LED_R
					int "RGB Led Red gpiohs number"
					default 11

				config GPIOHS_NUM_RGB_LED_G
					int "RGB Led Green gpiohs number"
					default 12

				config GPIOHS_NUM_RGB_LED_B
					int "RGB Led Blue gpiohs number"
					default 13
			endmenu
		endmenu

		menu "LCD BackLight configuration"

			config ENABLE_LCD_BL
				bool "enable lcd bl"
				default y

			config PIN_NUM_LCD_BL
				depends on ENABLE_LCD_BL
				int "lcd bl pin number"
				default 9

			config GPIOHS_NUM_LCD_BL
				depends on ENABLE_LCD_BL
				int "lcd bl gpiohs number"
				default 14
			
			config LCD_BL_OPEN_VOL
				depends on ENABLE_LCD_BL
				int "lcd bl open vol high or low"
				range 0 1
				default 0
		endmenu

	endmenu

	menu "NetWork"
		config NET_ENABLE
			bool "enable network"
			default n

		choice NET_IF_TYPE
			depends on NET_ENABLE
			bool "net interface type"
			default NET_ESP8285

			config NET_ESP8285
				bool "wifi, use esp8285"
				select ENABLE_WIFI
				---help---
				MF1 with M1w have a esp8285

			config NET_W5500
				bool "ethernet, use w5500"
				select ENABLE_W5500
				---help---
				should have a extended w5500 board
		endchoice

		menu "WiFi configuration"
			depends on NET_ESP8285

			config ENABLE_WIFI
				bool "enable wifi over esp8285"
				default y

			menu "WiFi Pin configuration"
				config PIN_NUM_WIFI_EN
					int "WiFi enable pin number"
					default 8
				config PIN_NUM_WIFI_TX
					int "wifi TX pin number"
					default 6
				config PIN_NUM_WIFI_RX
					int "wifi RX pin number"
					default 7

				comment "-------------------------"	

				config PIN_NUM_WIFI_SPI_SCLK 
					depends on ENABLE_WIFI
					int "WiFi simulate SPI SCLK pin"
					default 1
				config PIN_NUM_WIFI_SPI_MOSI
					depends on ENABLE_WIFI
					int "WiFi simulate SPI MOSI pin"
					default 3
				config PIN_NUM_WIFI_SPI_MISO
					depends on ENABLE_WIFI
					int "WiFi simulate SPI MISO pin"
					default 2
				config PIN_NUM_WIFI_SPI_CS
					depends on ENABLE_WIFI
					int "WiFi simulate SPI CS pin"
					default 0
			endmenu

			menu "WiFi Pin Func configuration"
			config GPIOHS_NUM_WIFI_EN 
				int "WiFi enable gpiohs number"
				default 15

			config GPIO_NUM_WIFI_TX
				int "WiFi Tx gpiohs number"
				default 0

			config GPIO_NUM_WIFI_RX
				int "WiFi Rx gpiohs number"
				default 1

			comment "-------------------------"	

			config GPIOHS_NUM_WIFI_SPI_CS
				depends on ENABLE_WIFI
				int "WiFi Spi Cs gpiohs number"
				default 16
			endmenu
		endmenu

		menu "W500 configuration"
			depends on NET_W5500

			config ENABLE_W5500
				bool "enable ethernet over w5500"
				default n

			menu "W5500 configuration"
				depends on ENABLE_W5500

				config PIN_NUM_ETH_W5500_MOSI 
					int "Ethernet Spi mosi pin"
					default 13

				config PIN_NUM_ETH_W5500_MISO
					int "Ethernet Spi miso pin"
					default 12

				config PIN_NUM_ETH_W5500_SCLK
					int "Ethernet Spi sclk pin"
					default 14

				config PIN_NUM_ETH_W5500_CS
					int "Ethernet Spi cs pin"
					default 31

				config PIN_NUM_ETH_W5500_RST
					int "Ethernet rst pin"
					---help---
					default not use this one pin
			endmenu

			menu "W5500 configuration"
				depends on ENABLE_W5500

				config ETH_GPIOHS_NUM_CS
					int "GPIOHS num of Ethernet W5500's cs pin"
					default 15

				config ETH_GPIOHS_NUM_RST
					int "GPIOHS num of Ethernet W5500's rst pin"
					default 16
			endmenu
		endmenu

	endmenu

	menu "Uart Protocol"
		config ENABLE_UART_PROTOCOL
			bool "enable uart proto"
			default y

		menu "Uart Proto Pin configuration"
			depends on ENABLE_UART_PROTOCOL
			config PIN_NUM_UART_PROTO_TX 
				int "Protocol uart port TX pin"
				default 5
			config PIN_NUM_UART_PROTO_RX
				int "Protocol uart port RX pin"
				default 4
			config PIN_NUM_UART_DEBUG_TX 
				int "Debug uart port TX pin"
				default 10
			config PIN_NUM_UART_DEBUG_RX
				int "Debug uart port RX pin"
				default 11
			config SWAP_UART_PROTO_DEBUG
				bool "Swap protocol uart pin and debug pin"
				default n
		endmenu

		menu "Output Jpeg configuration"
			depends on ENABLE_UART_PROTOCOL

			config ENABLE_OUTPUT_JPEG
				bool "enable output jpeg via uart"
				select ENABLE_CQUEUE
				select ENABLE_JPEG_ENCODE
				default n

			config OUTPUT_JPEG_UART_BAUD
				depends on ENABLE_OUTPUT_JPEG
				int "output jpeg uart baud"
				default 921600

			config JPEG_OUTPUT_PORT_TX
				depends on ENABLE_OUTPUT_JPEG
				int "Jpeg output uart pot tx"
				default 30
		endmenu

		config FACE_PASS_ONLY_OUT_UID
			depends on ENABLE_UART_PROTOCOL
			bool "face pass, protocol output only uid"
			default n

	endmenu

	comment "--------------------------------"

	config LCD_VERTICAL
		depends on LCD_TYPE_ST7789
		bool "Lcd display vertical"
		default n
		---help---
		lcd display vertical will use more memrory

	config LCD_HORIZONTAL
		depends on LCD_TYPE_ST7789
		bool "Lcd display hortizontal"
		default n
		---help---
		2.4 or 2.8 inch lcd with (320 x 240), display hortizontal

	config NOT_MF1_BOARD
		bool "not MF1 board"
		default n
		---help---
		build for Bit,Go,DOck or Othres

	comment "--------------------------------"

	config SHORT_PRESS_FUNCTION_KEY_RECORD_FACE
		bool "Short press button to record face"
		default y
    config LONG_PRESS_FUNCTION_KEY_CLEAR_FEATURE
        bool "Long press button to clear face feature"
        default y
    config LONG_PRESS_FUNCTION_KEY_RESTORE
        bool "Long press button to reset factory"
        default y

endmenu
```
